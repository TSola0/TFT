/**
 *******************************************************************************
 * @file    lcd.c
 * @brief   2.8 寸 SPI TFT 液晶驱动（ILI9341 控制器，320×240）实现
 *
 * 驱动分层：
 *   - Port 层 : SPI 收发与控制脚封装（LCD_WriteCmd / LCD_WriteData ...）
 *   - Init 层 : ILI9341 上电初始化序列（软件复位，无硬件 RST）
 *   - Draw 层 : 画点 / 填充 / 画线 / 图片 / 字符显示
 *
 * 性能说明：
 *   - 大面积填充与图片刷新使用 SPI1_TX DMA（CubeMX 已配置 DMA1_Channel3）；
 *   - 受 RAM 限制（20KB）不使用全屏帧缓冲，采用「写窗口 + 直推 GRAM」方案。
 *
 * @author  梦咕咕 & Shiro
 * @version V1.0
 * @date    2026-09-08
 *******************************************************************************
 */

/* Includes ------------------------------------------------------------------*/
#include "lcd.h"
#include "spi.h"
#include <string.h>

/* ============================ 私有类型定义 ================================= */

/** ILI9341 命令码定义（数据手册常用命令） */
#define ILI9341_SWRESET             0x01    /* 软件复位（本模块无 RST 脚，用它）  */
#define ILI9341_SLEEPOUT            0x11    /* 退出睡眠                          */
#define ILI9341_DISPLAYON           0x29    /* 开显示                            */
#define ILI9341_CASET               0x2A    /* 列地址设置（X 方向）              */
#define ILI9341_PASET               0x2B    /* 行地址设置（Y 方向）              */
#define ILI9341_RAMWR               0x2C    /* 开始写入 GRAM                     */
#define ILI9341_MADCTL              0x36    /* 内存数据访问控制（方向/BGR）      */
#define ILI9341_PIXFMT              0x3A    /* 像素格式（0x55 = RGB565）         */

/**
 * 各方向的 MADCTL 值（已置 BGR 位 0x08，保证 RGB565 颜色顺序正确）
 *   Bit7 MY / Bit6 MX / Bit5 MV / Bit3 BGR
 */
#define MADCTL_PORTAIT              0x48    /* 0: 竖屏  240x320                   */
#define MADCTL_LANDSCAPE            0x28    /* 1: 横屏  320x240                   */
#define MADCTL_PORTAIT_MIRROR       0x88    /* 2: 竖屏翻转 240x320                */
#define MADCTL_LANDSCAPE_MIRROR     0xE8    /* 3: 横屏翻转 320x240                */

/* ============================ 私有变量 ===================================== */

/** 当前屏幕方向（0~3），由 LCD_SetRotation 维护 */
static uint8_t s_rotation = LCD_ROTATION_DEFAULT;

/** 当前屏幕有效宽/高（像素），随方向变化 */
static uint16_t s_width  = 320;
static uint16_t s_height = 240;

/* ============================ 8x16 ASCII 字库 ============================= */
/**
 * @brief  8x16 ASCII 点阵字库（0x20~0x7E，共 95 个字符）
 * @note   由 Consolas 字体经脚本取模生成：每字符 16 字节，每字节为一行，
 *         bit7 在最左侧；使用 const 修饰，存放于 Flash，不占用 RAM
 */
static const uint8_t s_font8x16[95][16] =
{
    {0x00, 0x00, 0x00, 0x00, 0x00, 0x00, 0x00, 0x00, 0x00, 0x00, 0x00, 0x00, 0x00, 0x00, 0x00, 0x00}, /* ' ' */
    {0x00, 0x00, 0x00, 0x10, 0x10, 0x10, 0x10, 0x10, 0x00, 0x10, 0x10, 0x00, 0x00, 0x00, 0x00, 0x00}, /* '!' */
    {0x00, 0x00, 0x00, 0x68, 0x68, 0x28, 0x00, 0x00, 0x00, 0x00, 0x00, 0x00, 0x00, 0x00, 0x00, 0x00}, /* '"' */
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    {0x00, 0x00, 0x00, 0x00, 0x00, 0x00, 0x00, 0x74, 0xDC, 0x00, 0x00, 0x00, 0x00, 0x00, 0x00, 0x00}, /* '~' */
};

/* ============================ Port 层：底层读写 ============================ */

/**
 * @brief  向液晶写入一条命令
 * @param  cmd : 8bit 命令码
 * @retval 无
 */
static void LCD_WriteCmd(uint8_t cmd)
{
    LCD_DC_CMD();
    LCD_CS_LOW();
    HAL_SPI_Transmit(&LCD_SPI_HANDLE, &cmd, 1, 100);
    LCD_CS_HIGH();
}

/**
 * @brief  向液晶写入一段显示数据（阻塞方式，用于少量数据）
 * @param  buf : 数据缓冲区指针
 * @param  len : 数据长度（字节）
 * @retval 无
 */
static void LCD_WriteData(const uint8_t *buf, uint16_t len)
{
    LCD_DC_DATA();
    LCD_CS_LOW();
    HAL_SPI_Transmit(&LCD_SPI_HANDLE, (uint8_t *)buf, len, 1000);
    LCD_CS_HIGH();
}

/**
 * @brief  向液晶写入一个 16bit 像素颜色（高字节在前）
 * @param  color : RGB565 颜色值
 * @retval 无
 */
static void LCD_WriteData16(uint16_t color)
{
    uint8_t buf[2];

    buf[0] = (uint8_t)(color >> 8);
    buf[1] = (uint8_t)(color & 0xFF);
    LCD_WriteData(buf, 2);
}

/* ============================ Init 层：初始化 ============================== */

/**
 * @brief  ILI9341 上电初始化序列（含软件复位，本模块无硬件 RST 引脚）
 * @note   序列来自 ILI9341 数据手册推荐值，配合常见 2.8 寸模块参数
 * @retval 无
 */
void LCD_Init(void)
{
    /* --- 软件复位：代替硬件 RST 脚 --- */
    LCD_WriteCmd(ILI9341_SWRESET);
    HAL_Delay(150);

    /* --- 电源与驱动配置（模块厂调参数，一般无需改动） --- */
    LCD_WriteCmd(0xCF);                     /* Power Control B   */
    {
        const uint8_t v[3] = {0x00, 0xC1, 0x30};
        LCD_WriteData(v, 3);
    }
    LCD_WriteCmd(0xED);                     /* Power On Sequence */
    {
        const uint8_t v[4] = {0x64, 0x03, 0x12, 0x81};
        LCD_WriteData(v, 4);
    }
    LCD_WriteCmd(0xE8);                     /* Driver Timing A   */
    {
        const uint8_t v[3] = {0x85, 0x00, 0x78};
        LCD_WriteData(v, 3);
    }
    LCD_WriteCmd(0xCB);                     /* Power Control A   */
    {
        const uint8_t v[5] = {0x39, 0x2C, 0x00, 0x34, 0x02};
        LCD_WriteData(v, 5);
    }
    LCD_WriteCmd(0xF7);                     /* Pump Ratio Control*/
    {
        const uint8_t v[1] = {0x20};
        LCD_WriteData(v, 1);
    }
    LCD_WriteCmd(0xEA);                     /* Driver Timing B   */
    {
        const uint8_t v[2] = {0x00, 0x00};
        LCD_WriteData(v, 2);
    }

    LCD_WriteCmd(0xC0);                     /* Power Control 1: VRH */
    {
        const uint8_t v[1] = {0x23};
        LCD_WriteData(v, 1);
    }
    LCD_WriteCmd(0xC1);                     /* Power Control 2: BT  */
    {
        const uint8_t v[1] = {0x10};
        LCD_WriteData(v, 1);
    }
    LCD_WriteCmd(0xC5);                     /* VCOM Control 1       */
    {
        const uint8_t v[2] = {0x3E, 0x28};
        LCD_WriteData(v, 2);
    }
    LCD_WriteCmd(0xC7);                     /* VCOM Control 2       */
    {
        const uint8_t v[1] = {0x86};
        LCD_WriteData(v, 1);
    }

    /* --- 显示方向与像素格式 --- */
    LCD_SetRotation(s_rotation);            /* 内部完成 MADCTL 写入 */

    LCD_WriteCmd(ILI9341_PIXFMT);           /* 像素格式 RGB565 */
    {
        const uint8_t v[1] = {0x55};
        LCD_WriteData(v, 1);
    }

    LCD_WriteCmd(0xB1);                     /* 帧率控制: 60Hz */
    {
        const uint8_t v[2] = {0x00, 0x18};
        LCD_WriteData(v, 2);
    }
    LCD_WriteCmd(0xB6);                     /* 显示功能控制 */
    {
        const uint8_t v[3] = {0x08, 0x82, 0x27};
        LCD_WriteData(v, 3);
    }
    LCD_WriteCmd(0xF2);                     /* 3G Gamma 功能：关闭 */
    {
        const uint8_t v[1] = {0x00};
        LCD_WriteData(v, 1);
    }
    LCD_WriteCmd(0x26);                     /* Gamma 曲线选择：Set 1 */
    {
        const uint8_t v[1] = {0x01};
        LCD_WriteData(v, 1);
    }

    /* --- Gamma 校正（正/负极性） --- */
    LCD_WriteCmd(0xE0);                     /* Positive Gamma */
    {
        const uint8_t v[15] = {0x0F, 0x31, 0x2B, 0x0C, 0x0E, 0x08, 0x4E,
                               0xF1, 0x37, 0x07, 0x10, 0x03, 0x0E, 0x09, 0x00};
        LCD_WriteData(v, 15);
    }
    LCD_WriteCmd(0xE1);                     /* Negative Gamma */
    {
        const uint8_t v[15] = {0x00, 0x0E, 0x14, 0x03, 0x11, 0x07, 0x31,
                               0xC1, 0x48, 0x08, 0x0F, 0x0C, 0x31, 0x36, 0x0F};
        LCD_WriteData(v, 15);
    }

    /* --- 退出睡眠并开显示 --- */
    LCD_WriteCmd(ILI9341_SLEEPOUT);
    HAL_Delay(120);
    LCD_WriteCmd(ILI9341_DISPLAYON);
    HAL_Delay(20);

    /* 打开背光，点亮屏幕 */
    LCD_BL_ON();
}

/**
 * @brief  设置屏幕显示方向
 * @param  rotation : 0=竖屏(240x320) 1=横屏(320x240)
 *                    2=竖屏翻转     3=横屏翻转
 * @retval 无
 */
void LCD_SetRotation(uint8_t rotation)
{
    uint8_t madctl;

    switch (rotation)
    {
        case 0:
            madctl = MADCTL_PORTAIT;
            s_width  = 240;
            s_height = 320;
            break;
        case 1:
            madctl = MADCTL_LANDSCAPE;
            s_width  = 320;
            s_height = 240;
            break;
        case 2:
            madctl = MADCTL_PORTAIT_MIRROR;
            s_width  = 240;
            s_height = 320;
            break;
        case 3:
            madctl = MADCTL_LANDSCAPE_MIRROR;
            s_width  = 320;
            s_height = 240;
            break;
        default:
            return;                         /* 非法参数，直接忽略 */
    }

    s_rotation = rotation;
    LCD_WriteCmd(ILI9341_MADCTL);
    LCD_WriteData(&madctl, 1);
}

/**
 * @brief  获取当前方向
 * @retval 0~3
 */
uint8_t LCD_GetRotation(void)
{
    return s_rotation;
}

/**
 * @brief  获取当前屏幕有效宽度（像素）
 */
uint16_t LCD_GetWidth(void)
{
    return s_width;
}

/**
 * @brief  获取当前屏幕有效高度（像素）
 */
uint16_t LCD_GetHeight(void)
{
    return s_height;
}

/**
 * @brief  背光开关控制
 * @param  enable : 1=开背光 0=关背光
 */
void LCD_SetBacklight(uint8_t enable)
{
    if (enable)
    {
        LCD_BL_ON();
    }
    else
    {
        LCD_BL_OFF();
    }
}

/* ============================ Draw 层：绘图接口 ============================ */

/**
 * @brief  设置 GRAM 写窗口（之后连续写入的像素只落在此矩形内）
 * @note   这是省 RAM 的核心：不做全屏帧缓冲，全部按窗口局部刷新
 * @param  x1,y1 : 窗口左上角坐标
 * @param  x2,y2 : 窗口右下角坐标（含）
 */
void LCD_SetWindow(uint16_t x1, uint16_t y1, uint16_t x2, uint16_t y2)
{
    uint8_t buf[4];

    LCD_WriteCmd(ILI9341_CASET);            /* X 起止列地址 */
    buf[0] = (uint8_t)(x1 >> 8);
    buf[1] = (uint8_t)(x1 & 0xFF);
    buf[2] = (uint8_t)(x2 >> 8);
    buf[3] = (uint8_t)(x2 & 0xFF);
    LCD_WriteData(buf, 4);

    LCD_WriteCmd(ILI9341_PASET);            /* Y 起止行地址 */
    buf[0] = (uint8_t)(y1 >> 8);
    buf[1] = (uint8_t)(y1 & 0xFF);
    buf[2] = (uint8_t)(y2 >> 8);
    buf[3] = (uint8_t)(y2 & 0xFF);
    LCD_WriteData(buf, 4);

    LCD_WriteCmd(ILI9341_RAMWR);            /* 准备写 GRAM */
}

/**
 * @brief  画一个像素点
 * @param  x, y  : 坐标
 * @param  color : RGB565 颜色
 */
void LCD_DrawPoint(uint16_t x, uint16_t y, uint16_t color)
{
    LCD_SetWindow(x, y, x, y);
    LCD_WriteData16(color);
}

/**
 * @brief  矩形区域填充（背景、进度条、清屏等），DMA 分块发送
 * @param  x1,y1 : 矩形左上角
 * @param  x2,y2 : 矩形右下角（含）
 * @param  color : 填充颜色
 */
void LCD_Fill(uint16_t x1, uint16_t y1, uint16_t x2, uint16_t y2, uint16_t color)
{
    uint32_t total;
    uint16_t chunk;
    uint16_t i;

    /* DMA 期间缓冲区必须稳定存在，故使用 static 而非局部数组 */
    static uint16_t s_chunk[64];

    if ((x1 > x2) || (y1 > y2))
    {
        return;
    }

    for (i = 0; i < 64; i++)
    {
        s_chunk[i] = color;
    }

    total = (uint32_t)(x2 - x1 + 1) * (uint32_t)(y2 - y1 + 1);
    LCD_SetWindow(x1, y1, x2, y2);

    LCD_DC_DATA();
    LCD_CS_LOW();
    while (total > 0)
    {
        chunk = (total > 64) ? 64 : (uint16_t)total;
        HAL_SPI_Transmit_DMA(&LCD_SPI_HANDLE, (uint8_t *)s_chunk, chunk * 2);
        while (HAL_SPI_GetState(&LCD_SPI_HANDLE) != HAL_SPI_STATE_READY)
        {
            ;                               /* 等待本次 DMA 搬运完成 */
        }
        total -= chunk;
    }
    LCD_CS_HIGH();
}

/**
 * @brief  全屏清屏
 * @param  color : 背景颜色
 */
void LCD_Clear(uint16_t color)
{
    LCD_Fill(0, 0, s_width - 1, s_height - 1, color);
}

/**
 * @brief  画线段（Bresenham 直线算法，任意斜率）
 * @param  x1,y1 : 起点
 * @param  x2,y2 : 终点
 * @param  color : 线颜色
 */
void LCD_DrawLine(uint16_t x1, uint16_t y1, uint16_t x2, uint16_t y2, uint16_t color)
{
    int16_t dx;
    int16_t dy;
    int16_t sx;
    int16_t sy;
    int16_t err;
    int16_t e2;

    dx = (x2 > x1) ? (x2 - x1) : (x1 - x2);
    dy = (y2 > y1) ? (y2 - y1) : (y1 - y2);
    sx = (x1 < x2) ? 1 : -1;
    sy = (y1 < y2) ? 1 : -1;
    err = dx - dy;

    for (;;)
    {
        LCD_DrawPoint(x1, y1, color);

        if ((x1 == x2) && (y1 == y2))
        {
            break;
        }

        e2 = err * 2;
        if (e2 > -dy)
        {
            err -= dy;
            x1  += sx;
        }
        if (e2 < dx)
        {
            err += dx;
            y1  += sy;
        }
    }
}

/**
 * @brief  显示一张 RGB565 图片（取模：高位在前，水平扫描，不含图像头）
 * @note   图片数组务必加 const 存放于 Flash，避免占用宝贵的 20KB RAM
 * @param  x, y : 图片左上角坐标
 * @param  w, h : 图片宽高（像素）
 * @param  bmp  : RGB565 像素数组指针
 */
void LCD_DrawBitmap(uint16_t x, uint16_t y, uint16_t w, uint16_t h, const uint16_t *bmp)
{
    uint32_t remain;
    uint16_t chunk;
    const uint8_t *p;

    /* 单次 DMA 最大 65535 字节，这里按 16000 字节分块搬运 */
    remain = (uint32_t)w * h * 2;
    p = (const uint8_t *)bmp;

    LCD_SetWindow(x, y, x + w - 1, y + h - 1);

    LCD_DC_DATA();
    LCD_CS_LOW();
    while (remain > 0)
    {
        chunk = (remain > 16000) ? 16000 : (uint16_t)remain;
        HAL_SPI_Transmit_DMA(&LCD_SPI_HANDLE, (uint8_t *)p, chunk);
        while (HAL_SPI_GetState(&LCD_SPI_HANDLE) != HAL_SPI_STATE_READY)
        {
            ;                               /* 等待 DMA 完成 */
        }
        p      += chunk;
        remain -= chunk;
    }
    LCD_CS_HIGH();
}

/* ============================ Draw 层：字符显示 ============================ */

/**
 * @brief  在指定位置显示一个 ASCII 字符（8×16 点阵，含背景色）
 * @param  x, y : 字符左上角坐标
 * @param  ch   : 待显示字符（仅支持 0x20~0x7E，其余按空格处理）
 * @param  fg   : 前景色（字笔画颜色）
 * @param  bg   : 背景色
 */
void LCD_ShowChar(uint16_t x, uint16_t y, uint8_t ch, uint16_t fg, uint16_t bg)
{
    uint16_t buf[8 * 16];                   /* 128 像素 = 256 字节，阻塞发送可用栈缓冲 */
    const uint8_t *glyph;
    uint16_t idx;
    uint8_t row;
    uint8_t col;

    if ((ch < 0x20) || (ch > 0x7E))
    {
        ch = 0x20;                          /* 非法字符按空格显示 */
    }

    glyph = &s_font8x16[ch - 0x20][0];

    /* 将点阵展开为逐像素颜色数组 */
    idx = 0;
    for (row = 0; row < 16; row++)
    {
        for (col = 0; col < 8; col++)
        {
            buf[idx++] = (glyph[row] & (0x80 >> col)) ? fg : bg;
        }
    }

    LCD_SetWindow(x, y, x + 7, y + 15);
    LCD_DC_DATA();
    LCD_CS_LOW();
    HAL_SPI_Transmit(&LCD_SPI_HANDLE, (uint8_t *)buf, sizeof(buf), 500);
    LCD_CS_HIGH();
}

/**
 * @brief  显示一串 ASCII 字符（自动换行到下一行继续显示）
 * @param  x, y   : 首字符左上角坐标
 * @param  str    : 字符串（以 '\0' 结尾）
 * @param  fg, bg : 前景 / 背景色
 */
void LCD_ShowString(uint16_t x, uint16_t y, const char *str, uint16_t fg, uint16_t bg)
{
    uint16_t cx = x;
    uint16_t cy = y;

    if (str == NULL)
    {
        return;
    }

    while (*str != '\0')
    {
        if (*str == '\n')                   /* 换行：回到行首，下移 16 像素 */
        {
            cx  = x;
            cy += 16;
            str++;
            continue;
        }

        LCD_ShowChar(cx, cy, (uint8_t)*str, fg, bg);
        cx += 8;
        str++;

        if ((cx + 8) > s_width)             /* 超出屏幕宽度自动换行 */
        {
            cx  = x;
            cy += 16;
        }
    }
}
